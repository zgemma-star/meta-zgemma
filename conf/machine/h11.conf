## conf/machine/h11.conf
```bitbake
#@TYPE: Machine
#@NAME: h11
#@DESCRIPTION: Machine configuration for the h9se

MACHINE_FEATURES += " blindscan dvb-c hisil hisil-3798mv310 mali transcoding wol emmc"
OPENPLI_FEATURES += " ci qtplugins kodi"
DISTRO_FEATURES_remove = "x11 wayland directfb"

# TARGET_ARCH = "aarch64"
# DEFAULTTUNE = "aarch64"
TARGET_ARCH = "arm"
DEFAULTTUNE = "cortexa15hf-neon-vfpv4"

IMAGE_CLASSES += " zgemma-fastboot8gb_image"
IMAGE_FSTYPES += " zgemmafastboot8gb tar"
CMDLINE ?= "console=ttyAMA0,115200n8"

HICHIPSET = "3798mv310"
CHIPSET = "Hi3798Mv310"
RCTYPE = "28"

require conf/machine/include/zgemma-hisil-3798mv310.inc
```

## conf/machine/h3.conf
```bitbake
#@TYPE: Machine
#@NAME: h3
#@DESCRIPTION: Machine configuration for h3

MKUBIFS_ARGS = "-m 2048 -e 126976 -c 8192"
UBINIZE_ARGS = "-m 2048 -p 128KiB"

MACHINE_FEATURES += " textlcd 7segment dvb-c RCA"
DISTRO_FEATURES_remove = "x11 wayland directfb"

CHIPSET = "bcm7362"
RCTYPE = "21"

FORCE = "no"

require conf/machine/include/zgemma-mipsel.inc

SOC_FAMILY = "bcm7362"
```

## conf/machine/h4.conf
```bitbake
#@TYPE: Machine
#@NAME: h4
#@DESCRIPTION: Machine configuration for h4

MKUBIFS_ARGS = "-m 2048 -e 126976 -c 8192"
UBINIZE_ARGS = "-m 2048 -p 128KiB"

MACHINE_FEATURES += " textlcd 7segment dvb-c"
DISTRO_FEATURES_remove = "x11 wayland directfb"

CHIPSET = "bcm7583"
RCTYPE = "21"

FORCE = "no"

require conf/machine/include/zgemma-mipsel.inc
```

## conf/machine/h5.conf
```bitbake
#@TYPE: Machine
#@NAME: h5
#@DESCRIPTION: Machine configuration for h5

MKUBIFS_ARGS = "-m 2048 -e 126976 -c 8192"
UBINIZE_ARGS = "-m 2048 -p 128KiB"

MACHINE_FEATURES += "textlcd 7segment dvb-c h265"
DISTRO_FEATURES_remove = "x11 wayland directfb"

CHIPSET = "bcm73625"
RCTYPE = "21"

FORCE = "no"

require conf/machine/include/zgemma-mipsel.inc
```

## conf/machine/h6.conf
```bitbake
#@TYPE: Machine
#@NAME: h6
#@DESCRIPTION: Machine configuration for h6

MKUBIFS_ARGS = "-m 2048 -e 126976 -c 8192"
UBINIZE_ARGS = "-m 2048 -p 128KiB"

MACHINE_FEATURES += " textlcd 7segment dvb-c h265"
OPENPLI_FEATURES += " ci"
DISTRO_FEATURES_remove = "x11 wayland directfb"

CHIPSET = "bcm73625"
RCTYPE = "21"

FORCE = "no"

require conf/machine/include/zgemma-mipsel.inc
```

## conf/machine/h7.conf
```bitbake
#@TYPE: Machine
#@NAME: h7
#@DESCRIPTION: Machine configuration for the h7

MACHINE_FEATURES += " textlcd 7segment dvb-c v3d-cortexa15 emmc"
OPENPLI_FEATURES += " ci qtplugins kodi openhbbtvbrowser"
DISTRO_FEATURES_remove = "x11 wayland directfb"

TARGET_ARCH = "arm"
DEFAULTTUNE = "cortexa15hf-neon-vfpv4"

IMAGE_CLASSES += "zgemma-emmc_image_multiboot"
IMAGE_FSTYPES += "zgemmc tar"
IMAGE_ROOTFS_SIZE ?= "294912"

CHIPSET = "bcm7251s"
RCTYPE = "21"

require conf/machine/include/zgemma-cortex-a15.inc
```

## conf/machine/h8.conf
```bitbake
#@TYPE: Machine
#@NAME: h8
#@DESCRIPTION: Machine configuration for the h8

MACHINE_FEATURES += " no-opengl hisil hisil-3716mv430 dvb-c"
OPENPLI_FEATURES += " qtplugins"
DISTRO_FEATURES_remove = "x11 directfb"

# TARGET_ARCH = "aarch64"
# DEFAULTTUNE = "aarch64"
TARGET_ARCH = "arm"
DEFAULTTUNE = "cortexa7thf"
# DEFAULTTUNE = "cortexa9thf-vfpv3"

IMAGE_CLASSES += " zgemma-ubi_image"
IMAGE_FSTYPES += " ubi zgemmaubi"
MKUBIFS_ARGS = "-m 4096 -e 253952 -c 2048"
UBINIZE_ARGS = "-m 4096 -p 256KiB -s 4096"
UBI_VOLNAME = "rootfs"
CMDLINE ?= "console=ttyAMA0,115200n8"
MTD_KERNEL = "mtd9"

HICHIPSET = "3716mv430"
CHIPSET = "Hi3716Mv430"
RCTYPE = "25"

FORCE = "no"

require conf/machine/include/zgemma-hisil-3716mv430.inc
```

## conf/machine/h9.conf
```bitbake
#@TYPE: Machine
#@NAME: h9
#@DESCRIPTION: Machine configuration for the h9

MACHINE_FEATURES += " blindscan dvb-c hisil-3798mv200 mali transcoding"
OPENPLI_FEATURES += " qtplugins kodi"
DISTRO_FEATURES_remove = "x11 wayland directfb"

# TARGET_ARCH = "aarch64"
# DEFAULTTUNE = "aarch64"
TARGET_ARCH = "arm"
DEFAULTTUNE = "cortexa15hf-neon-vfpv4"

IMAGE_FSTYPES += " ubi"
MKUBIFS_ARGS = "-m 2048 -e 126976 -c 8192"
UBINIZE_ARGS = "-m 2048 -p 128KiB"
UBI_VOLNAME = "rootfs"
CMDLINE ?= "console=ttyAMA0,115200n8"
MTD_KERNEL = "mtd7"

CHIPSET = "Hi3798Mv200"
RCTYPE = "28"

FORCE = "no"

require conf/machine/include/zgemma-hisil-3798mv200.inc
```

## conf/machine/h9combo.conf
```bitbake
#@TYPE: Machine
#@NAME: h9combo
#@DESCRIPTION: Machine configuration for the h9combo

MACHINE_FEATURES += " textlcd 7segment blindscan dvb-c hisil hisil-3798mv200 hisil-recovery mali transcoding wol emmc"
OPENPLI_FEATURES += " ci qtplugins kodi"
DISTRO_FEATURES_remove = "x11 wayland directfb"

# TARGET_ARCH = "aarch64"
# DEFAULTTUNE = "aarch64"
TARGET_ARCH = "arm"
DEFAULTTUNE = "cortexa15hf-neon-vfpv4"

IMAGE_CLASSES += " zgemma-fastboot8gb_image"
IMAGE_FSTYPES += " zgemmafastboot8gb tar.bz2"
CMDLINE ?= "console=ttyAMA0,115200n8"

HICHIPSET = "3798mv200"
CHIPSET = "Hi3798Mv200"
RCTYPE = "28"

require conf/machine/include/zgemma-hisil-3798mv200.inc
```

## conf/machine/h9combose.conf
```bitbake
#@TYPE: Machine
#@NAME: h9combose
#@DESCRIPTION: Machine configuration for the h9combose

MACHINE_FEATURES += " textlcd 7segment blindscan dvb-c hisil hisil-3798mv200 mali transcoding wol emmc ciplus-helper"
OPENPLI_FEATURES += " ci qtplugins kodi"
DISTRO_FEATURES_remove = "x11 wayland directfb"

# TARGET_ARCH = "aarch64"
# DEFAULTTUNE = "aarch64"
TARGET_ARCH = "arm"
DEFAULTTUNE = "cortexa15hf-neon-vfpv4"

IMAGE_CLASSES += " zgemma-fastboot8gb_image"
IMAGE_FSTYPES += " zgemmafastboot8gb tar"
CMDLINE ?= "console=ttyAMA0,115200n8"

HICHIPSET = "3798mv200"
CHIPSET = "Hi3798Mv200"
RCTYPE = "28"

require conf/machine/include/zgemma-hisil-3798mv200.inc
```

## conf/machine/hzero.conf
```bitbake
#@TYPE: Machine
#@NAME: hzero
#@DESCRIPTION: Machine configuration for the hzero

MACHINE_FEATURES += " no-opengl hisil hisil-3716mv430 ci"
OPENPLI_FEATURES += " qtplugins"
DISTRO_FEATURES_remove = "x11 directfb"

# TARGET_ARCH = "aarch64"
# DEFAULTTUNE = "aarch64"
TARGET_ARCH = "arm"
DEFAULTTUNE = "cortexa7thf"
# DEFAULTTUNE = "cortexa9thf-vfpv3"

IMAGE_CLASSES += " zgemma-ubi_image"
IMAGE_FSTYPES += " ubi zgemmaubi"
MKUBIFS_ARGS = "-m 2048 -e 126976 -c 4096"
UBINIZE_ARGS = "-m 2048 -p 128KiB"
UBI_VOLNAME = "rootfs"
CMDLINE ?= "console=ttyAMA0,115200n8"
MTD_KERNEL = "mtd9"

HICHIPSET = "3716mv430"
CHIPSET = "Hi3716Mv430"
RCTYPE = "25"

FORCE = "no"

require conf/machine/include/zgemma-hisil-3716mv430.inc
```

## conf/machine/i55.conf
```bitbake
#@TYPE: Machine
#@NAME: i55
#@DESCRIPTION: Machine configuration for i55

MKUBIFS_ARGS = "-m 2048 -e 126976 -c 8192"
UBINIZE_ARGS = "-m 2048 -p 128KiB"

CHIPSET = "bcm7362"
RCTYPE = "22"

require conf/machine/include/zgemma.inc
```

## conf/machine/i55plus.conf
```bitbake
#@TYPE: Machine
#@NAME: i55plus
#@DESCRIPTION: Machine configuration for the i55plus

MACHINE_FEATURES += " hisil hisil-3798mv200 mali transcoding wol"
OPENPLI_FEATURES += " qtplugins kodi openhbbtvbrowser"
DISTRO_FEATURES_remove = "x11 wayland directfb"

# TARGET_ARCH = "aarch64"
# DEFAULTTUNE = "aarch64"
TARGET_ARCH = "arm"
DEFAULTTUNE = "cortexa15hf-neon-vfpv4"

IMAGE_FSTYPES += " ubi"
MKUBIFS_ARGS = "-m 2048 -e 126976 -c 8192"
UBINIZE_ARGS = "-m 2048 -p 128KiB"
UBI_VOLNAME = "rootfs"
CMDLINE ?= "console=ttyAMA0,115200n8"
MTD_KERNEL = "mtd6"

HICHIPSET = "3798mv200"
CHIPSET = "Hi3798Mv200"
RCTYPE = "25"

FORCE = "no"

require conf/machine/include/zgemma-hisil-3798mv200.inc
```

## conf/machine/i55se.conf
```bitbake
#@TYPE: Machine
#@NAME: i55se
#@DESCRIPTION: Machine configuration for the i55se

MACHINE_FEATURES += " hisil hisil-3798mv200 mali transcoding wol emmc"
OPENPLI_FEATURES += " ci qtplugins kodi"
DISTRO_FEATURES_remove = "x11 wayland directfb"

# TARGET_ARCH = "aarch64"
# DEFAULTTUNE = "aarch64"
TARGET_ARCH = "arm"
DEFAULTTUNE = "cortexa15hf-neon-vfpv4"

IMAGE_CLASSES += " zgemma-fastboot8gb_image"
IMAGE_FSTYPES += " zgemmafastboot8gb tar"
CMDLINE ?= "console=ttyAMA0,115200n8"

HICHIPSET = "3798mv200"
CHIPSET = "Hi3798Mv200"
RCTYPE = "28"

require conf/machine/include/zgemma-hisil-3798mv200.inc

MTD_BOOTFS = "mmcblk0p4"
MTD_ROOTFS = "mmcblk0p23"
MTD_KERNEL = "mmcblk0p19"
KERNEL_FILE = "uImage"
ROOTFS_FILE = "rootfs.tar.bz2"
MTD_BLACK  = "mmcblk0"
```

## conf/machine/include/zgemma-cortex-a15.inc
```bitbake
KERNEL_MODULE_AUTOLOAD += "xfs"

# We know about rtc
MACHINE_FEATURES_BACKFILL_CONSIDERED = "rtc"

PREFERRED_VERSION_linux-zgemma = "4.10.12"

#Provider
PREFERRED_PROVIDER_virtual/kernel ?= "linux-zgemma"
PREFERRED_PROVIDER_virtual/egl ?= "zgemma-v3ddriver-${MACHINE}"
PREFERRED_PROVIDER_virtual/libgles1 ?= "zgemma-v3ddriver-${MACHINE}"
PREFERRED_PROVIDER_virtual/libgles2 ?= "zgemma-v3ddriver-${MACHINE}"
PREFERRED_PROVIDER_virtual/libgbm ?= "zgemma-v3ddriver-${MACHINE}"
PREFERRED_PROVIDER_virtual/libgl ?= "mesa"
PREFERRED_PROVIDER_virtual/mesa ?= "mesa"
PREFERRED_PROVIDER_virtual/blindscan-dvbc ?= "zgemma-dvb-modules-${MACHINE}"
PREFERRED_PROVIDER_virtual/blindscan-dvbs ?= "zgemma-dvb-modules-${MACHINE}"

require conf/machine/include/tune-cortexa15.inc
require conf/machine/include/zgemma-essential.inc

# Qt
PACKAGECONFIG_GL_pn-qtbase = " "
PACKAGECONFIG_append_pn-qtbase += " gles2 linuxfb"

# Kodi
EXTRA_OECONF_append_pn-kodi = " --with-gpu=v3d"

MACHINE_EXTRA_RRECOMMENDS = " \
	gst-plugin-dvbmediasink \
	ntfs-3g \
	"

DVBMEDIASINK_CONFIG = "--with-h265 --with-vb8 --with-vb9 --with-wma --with-wmv --with-pcm --with-dts --with-eac3"

MACHINE_FEATURES += "alsa usbhost wlan 3dtv switchoff osdposition hdmicec"

IMAGEVERSION := "${DISTRO_NAME}-${DISTRO_VERSION}-${DATE}"
IMAGEVERSION[vardepsexclude] = "DATE"
IMAGEDIR ?= "zgemma/${MACHINE}"
IMGDEPLOYDIR ?= "${DEPLOY_DIR_IMAGE}"

IMAGE_CMD_zgemmc_append = "\
	mkdir -p ${IMGDEPLOYDIR}/${IMAGEDIR}; \
	cp ${IMGDEPLOYDIR}/${IMAGE_NAME}.emmc.img ${IMGDEPLOYDIR}/${IMAGEDIR}/disk.img; \
	echo "${IMAGEVERSION}" > ${IMGDEPLOYDIR}/${IMAGEDIR}/imageversion; \
	cp ${DEPLOY_DIR_IMAGE}/zImage ${IMGDEPLOYDIR}/${IMAGEDIR}/kernel.bin; \
	cp ${IMGDEPLOYDIR}/${IMAGE_NAME}${IMAGE_NAME_SUFFIX}.tar ${IMGDEPLOYDIR}/${IMAGEDIR}/rootfs.tar; \
	bzip2 ${IMGDEPLOYDIR}/${IMAGEDIR}/rootfs.tar; \
	cd ${IMGDEPLOYDIR}; \
	zip ${DISTRO_NAME}-${DISTRO_VERSION}-${MACHINE}_usb.zip ${IMAGEDIR}/disk.img ${IMAGEDIR}/imageversion; \
	zip ${DISTRO_NAME}-${DISTRO_VERSION}-${MACHINE}_multiboot_ofgwrite.zip ${IMAGEDIR}/imageversion ${IMAGEDIR}/kernel.bin ${IMAGEDIR}/rootfs.tar.bz2; \
	rm -Rf ${IMAGEDIR}; \
"
```

## conf/machine/include/zgemma-essential.inc
```bitbake
MACHINE_ESSENTIAL_EXTRA_RDEPENDS = "\
	zgemma-dvb-modules-${MACHINE} \
	${@bb.utils.contains('MACHINE_FEATURES', 'hisil-3798mv200', 'zgemma-libs-3798mv200 zgemma-param-3798mv200 zgemma-bootargs-3798mv200 zgemma-bootlogo-3798mv200 zgemma-fastboot-3798mv200 tntfs' , '', d)} \
	${@bb.utils.contains('MACHINE_FEATURES', 'hisil-3798mv200 emmc', 'zgemma-recovery-3798mv200' , '', d)} \
	\
	${@bb.utils.contains('MACHINE_FEATURES', 'hisil-3716mv430', 'zgemma-libs-3716mv430 zgemma-param-3716mv430 zgemma-bootargs-3716mv430 zgemma-bootlogo-3716mv430 zgemma-fastboot-3716mv430 tntfs' , '', d)} \
	"

MACHINE_ESSENTIAL_EXTRA_RRECOMMENDS = "\
	kernel-module-cdfs \
	\
	${@bb.utils.contains('MACHINE_FEATURES', 'v3d-nxpl', 'zgemma-v3ddriver-${MACHINE}' , '', d)} \
	${@bb.utils.contains('MACHINE_FEATURES', 'hisil-3798mv200', 'kernel-module-mali-3798mv200 zgemma-mali-3798mv200' , '', d)} \
	${@bb.utils.contains('MACHINE_FEATURES', 'wol', 'zgemma-ethwol' , '', d)} \
	${@bb.utils.contains('MACHINE_FEATURES', 'emmc', 'resizerootfs partitions-by-name' , '', d)} \
	${@bb.utils.contains('MACHINE_FEATURES', 'bluetooth', 'kernel-module-btusb bluez5' , '', d)} \
	\
	firmware-mt7601u \
	firmware-rtl8188eu \
	firmware-rtl8192eu \
	firmware-rtl8723bu \
	firmware-rtl8xxxu \
	\
	kernel-module-8192eu \
	kernel-module-8723bu \
	kernel-module-88x2bu \
	\
	kernel-module-mt7601u \
	kernel-module-r8723au \
	kernel-module-r8188eu \
	kernel-module-rtl8xxxu \
	"

OPTIONAL_EXTRA_DVBUSB_PACKAGES = "\
	enigma2-plugin-drivers-ct2-usb-xbox-one-tuner \
	"
```

## conf/machine/include/zgemma-hisil-3716mv430.inc
```bitbake
MACHINE_KERNEL_PR = "r0"
KERNEL_MODULE_AUTOLOAD += "xfs"

# We know about rtc
MACHINE_FEATURES_BACKFILL_CONSIDERED = "rtc"

PREFERRED_VERSION_linux-zgemma = "4.4.35"

#Provider
PREFERRED_PROVIDER_virtual/kernel ?= "linux-zgemma"
PREFERRED_PROVIDER_virtual/gstreamer1.0-dvbmediasink ?= "gstreamer1.0-plugin-dvbmediasink"
PREFERRED_PROVIDER_virtual/enigma2-mediaservice ?= "enigma2-plugin-systemplugins-servicehisilicon"

require conf/machine/include/tune-cortexa7.inc
require conf/machine/include/zgemma-essential.inc

# E2 OSD settings
EXTRA_OECONF_append_pn-enigma2 += " --with-alphablendingacceleration=always --with-blitaccelerationthreshold=250 --with-fillaccelerationthreshold=190000"

# Qt
PACKAGECONFIG_GL_pn-qtbase = " "
PACKAGECONFIG_append_pn-qtbase += " linuxfb no-opengl"

# Gstreamer dvbmediasink
DVBMEDIASINK_CONFIG = "--with-h265 --with-vb8 --with-wma --with-wmv --with-pcm  --with-eac3 --with-amr --with-spark"

MACHINE_EXTRA_RRECOMMENDS = " \
	ntfs-3g \
"

MACHINE_FEATURES += " alsa usbhost wlan 3dtv switchoff osdposition hdmicec"

IMAGEVERSION := "${DISTRO_NAME}-${DISTRO_VERSION}-${DATE}"
IMAGEVERSION[vardepsexclude] = "DATE"
IMAGEDIR ?= "zgemma"
IMAGEDIRRECOVERY ?= "zgemma-recovery"
IMGDEPLOYDIR ?= "${DEPLOY_DIR_IMAGE}"

IMAGE_CMD_ubifs_prepend = " \
	rm -Rf ${IMAGE_ROOTFS}/boot/*; \
	rm -Rf ${IMAGE_ROOTFS}/tmp/*; \
	"

IMAGE_CMD_ubi_append = " \
	mkdir -p ${IMGDEPLOYDIR}/${IMAGEDIR}/${MACHINE}; \
	cp ${IMGDEPLOYDIR}/${IMAGE_NAME}${IMAGE_NAME_SUFFIX}.ubi ${IMGDEPLOYDIR}/${IMAGEDIR}/${MACHINE}/rootfs.ubi; \
	cp ${DEPLOY_DIR_IMAGE}/uImage ${IMGDEPLOYDIR}/${IMAGEDIR}/${MACHINE}/uImage; \
	cp ${IMGDEPLOYDIR}/bootoptions.img ${IMGDEPLOYDIR}/${IMAGEDIR}/${MACHINE}/bootoptions.img; \
	cp ${DEPLOY_DIR_IMAGE}/zgemma-partitions-${MACHINE}/update_bootargs_${MACHINE}.bin ${IMGDEPLOYDIR}/${IMAGEDIR}/update_bootargs_${MACHINE}.bin; \
	cp ${DEPLOY_DIR_IMAGE}/zgemma-partitions-${MACHINE}/${MACHINE}/fastboot.bin ${IMGDEPLOYDIR}/${IMAGEDIR}/${MACHINE}/fastboot.bin; \
	cp ${DEPLOY_DIR_IMAGE}/zgemma-partitions-${MACHINE}/${MACHINE}/bootargs.bin ${IMGDEPLOYDIR}/${IMAGEDIR}/${MACHINE}/bootargs.bin; \
	cp ${DEPLOY_DIR_IMAGE}/zgemma-partitions-${MACHINE}/${MACHINE}/pq_param.bin ${IMGDEPLOYDIR}/${IMAGEDIR}/${MACHINE}/pq_param.bin; \
	cp ${DEPLOY_DIR_IMAGE}/zgemma-partitions-${MACHINE}/${MACHINE}/baseparam.img ${IMGDEPLOYDIR}/${IMAGEDIR}/${MACHINE}/baseparam.img; \
	cp ${DEPLOY_DIR_IMAGE}/zgemma-partitions-${MACHINE}/${MACHINE}/logo.img ${IMGDEPLOYDIR}/${IMAGEDIR}/${MACHINE}/logo.img; \
	echo "${IMAGEVERSION}" > ${IMGDEPLOYDIR}/${IMAGEDIR}/imageversion; \
	cd ${IMGDEPLOYDIR}/${IMAGEDIR}; \
	zip -r ../${DISTRO_NAME}-${DISTRO_VERSION}-${MACHINE}_usb.zip *; \
	cd ..; \
	rm -Rf ${IMAGEDIR}; \
	"
```
